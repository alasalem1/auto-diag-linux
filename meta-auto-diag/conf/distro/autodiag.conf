## meta-auto-diag/conf/layer.conf
```bitbake
BBPATH .= ":${LAYERDIR}"

BBFILES += "${LAYERDIR}/recipes-*/*/*.bb \
            ${LAYERDIR}/recipes-*/*/*.bbappend"

BBFILE_COLLECTIONS += "meta-auto-diag"
BBFILE_PATTERN_meta-auto-diag = "^${LAYERDIR}/"
BBFILE_PRIORITY_meta-auto-diag = "6"

LAYERSERIES_COMPAT_meta-auto-diag = "scarthgap"
```
